## build/Kconfig/boards/Kconfig.sysbuild
```kconfig
# Load Sysbuild board Kconfig descriptions.
osource "C:/ncs/v3.4.1/zephyr/boards/nordic/nrf52840dk/Kconfig.sysbuild"
```

## build/aquatic_biomonitor_fw/Kconfig/boards/Kconfig.nrf52840dk
```kconfig
# Load board Kconfig descriptions.
osource "C:/ncs/v3.4.1/zephyr/boards/nordic/nrf52840dk/Kconfig.nrf52840dk"
```
